#include "includes.h"
#define Smilescreen

void ILI9325_Initial(void)
{ 
	GPIO_InitTypeDef GPIO_InitStructure;
	FSMC_NORSRAMInitTypeDef  FSMC_NORSRAMInitStructure;
  	FSMC_NORSRAMTimingInitTypeDef  p;

	RCC_APB2PeriphClockCmd(RCC_APB2Periph_GPIOB|RCC_APB2Periph_GPIOD|RCC_APB2Periph_GPIOE|RCC_APB2Periph_GPIOG|RCC_APB2Periph_AFIO, ENABLE );
	RCC_AHBPeriphClockCmd(RCC_AHBPeriph_FSMC,ENABLE);

	GPIO_InitStructure.GPIO_Pin = GPIO_Pin_0;
	GPIO_InitStructure.GPIO_Speed = GPIO_Speed_50MHz;
	GPIO_InitStructure.GPIO_Mode = GPIO_Mode_Out_PP;
	GPIO_Init(GPIOB, &GPIO_InitStructure);

//	GPIO_InitStructure.GPIO_Pin = GPIO_Pin_4;
//	GPIO_InitStructure.GPIO_Speed = GPIO_Speed_50MHz;
//	GPIO_InitStructure.GPIO_Mode = GPIO_Mode_Out_PP;
//	GPIO_Init(GPIOC, &GPIO_InitStructure);

	GPIO_InitStructure.GPIO_Pin = GPIO_Pin_0|GPIO_Pin_1|GPIO_Pin_4|GPIO_Pin_5|GPIO_Pin_8|GPIO_Pin_9|GPIO_Pin_10|GPIO_Pin_14|GPIO_Pin_15;
	GPIO_InitStructure.GPIO_Speed = GPIO_Speed_50MHz;
	GPIO_InitStructure.GPIO_Mode = GPIO_Mode_AF_PP;
	GPIO_Init(GPIOD, &GPIO_InitStructure);

	GPIO_InitStructure.GPIO_Pin = GPIO_Pin_7|GPIO_Pin_8|GPIO_Pin_9|GPIO_Pin_10|GPIO_Pin_11|GPIO_Pin_12|GPIO_Pin_13|GPIO_Pin_14|GPIO_Pin_15;
	GPIO_InitStructure.GPIO_Speed = GPIO_Speed_50MHz;
	GPIO_InitStructure.GPIO_Mode = GPIO_Mode_AF_PP;
	GPIO_Init(GPIOE, &GPIO_InitStructure);

	GPIO_InitStructure.GPIO_Pin = GPIO_Pin_0|GPIO_Pin_12;
	GPIO_InitStructure.GPIO_Speed = GPIO_Speed_50MHz;
	GPIO_InitStructure.GPIO_Mode = GPIO_Mode_AF_PP;
	GPIO_Init(GPIOG, &GPIO_InitStructure);

	
	GPIO_SetBits(GPIOD,GPIO_Pin_All);
	GPIO_SetBits(GPIOE,GPIO_Pin_All);
	GPIO_SetBits(GPIOG,GPIO_Pin_All);
	GPIO_SetBits(GPIOB,GPIO_Pin_All);
	GPIO_SetBits(GPIOC,GPIO_Pin_All);

	RESET(1);

	/*-- FSMC Configuration ------------------------------------------------------*/ 
	/*----------------------- SRAM Bank 1 ----------------------------------------*/ 
	/* FSMC_Bank1_NORSRAM1configuration */ 
	p.FSMC_AddressSetupTime = 0;  //   1
	p.FSMC_AddressHoldTime = 0;    // 0
	p.FSMC_DataSetupTime = 3;   //  5
	p.FSMC_BusTurnAroundDuration = 0; 
	p.FSMC_CLKDivision = 0; 
	p.FSMC_DataLatency = 0; 
	p.FSMC_AccessMode = FSMC_AccessMode_A; 

	FSMC_NORSRAMInitStructure.FSMC_Bank = FSMC_Bank1_NORSRAM4;  
	FSMC_NORSRAMInitStructure.FSMC_DataAddressMux = FSMC_DataAddressMux_Disable; 
//	FSMC_NORSRAMInitStructure.FSMC_MemoryType = FSMC_MemoryType_NOR;  
	FSMC_NORSRAMInitStructure.FSMC_MemoryType = FSMC_MemoryType_SRAM;  
	FSMC_NORSRAMInitStructure.FSMC_MemoryDataWidth = FSMC_MemoryDataWidth_16b;  
	FSMC_NORSRAMInitStructure.FSMC_BurstAccessMode = FSMC_BurstAccessMode_Disable;  
	FSMC_NORSRAMInitStructure.FSMC_WaitSignalPolarity = FSMC_WaitSignalPolarity_Low;  
	FSMC_NORSRAMInitStructure.FSMC_WrapMode = FSMC_WrapMode_Disable;  
	FSMC_NORSRAMInitStructure.FSMC_WaitSignalActive = FSMC_WaitSignalActive_BeforeWaitState;  
	FSMC_NORSRAMInitStructure.FSMC_WriteOperation = FSMC_WriteOperation_Enable;  
	FSMC_NORSRAMInitStructure.FSMC_WaitSignal = FSMC_WaitSignal_Disable;  
//	FSMC_NORSRAMInitStructure.FSMC_ExtendedMode = FSMC_ExtendedMode_Disable; 
	FSMC_NORSRAMInitStructure.FSMC_ExtendedMode = FSMC_ExtendedMode_Enable;  
	FSMC_NORSRAMInitStructure.FSMC_WriteBurst = FSMC_WriteBurst_Disable;  
	FSMC_NORSRAMInitStructure.FSMC_ReadWriteTimingStruct = &p; 
	FSMC_NORSRAMInitStructure.FSMC_WriteTimingStruct = &p;   
	
	FSMC_NORSRAMInit(&FSMC_NORSRAMInitStructure); 
	
	/* Enable FSMC Bank1_SRAM Bank */
	FSMC_NORSRAMCmd(FSMC_Bank1_NORSRAM4, ENABLE);

	//CS(1);
//	delayms(5);
//	RESET(0);
//	delayms(50);
//	RESET(1);
//	delayms(50);
	//CS(0);  	
//	delayms(5);
/*	RESET(1);
	delayms(8);
	RESET(0);
	delayms(8);
	RESET(1);
//	delayms(8); */
	
	
	//delayms(50);
	//************* Start Initial Sequence **********//
#ifdef Smilescreen
    	Write_Cmd_Data(0x00,0x0000);
		Write_Cmd_Data(0x01,0x0100);	//Driver Output Contral.
		Write_Cmd_Data(0x02,0x0700);	//LCD Driver Waveform Contral.
		Write_Cmd_Data(0x03,0x1030);//Entry Mode Set.
//Write_Cmd_Data(0x03,0x1018);	//Entry Mode Set.
	
		Write_Cmd_Data(0x04,0x0000);	//Scalling Contral.
		Write_Cmd_Data(0x08,0x0202);	//Display Contral 2.(0x0207)
		Write_Cmd_Data(0x09,0x0000);	//Display Contral 3.(0x0000)
		Write_Cmd_Data(0x0a,0x0000);	//Frame Cycle Contal.(0x0000)
		Write_Cmd_Data(0x0c,(1<<0));	//Extern Display Interface Contral 1.(0x0000)
		Write_Cmd_Data(0x0d,0x0000);	//Frame Maker Position.
		Write_Cmd_Data(0x0f,0x0000);	//Extern Display Interface Contral 2.	    
		delayms(12); 
		Write_Cmd_Data(0x07,0x0101);	//Display Contral.
		delayms(12); 								  
		Write_Cmd_Data(0x10,(1<<12)|(0<<8)|(1<<7)|(1<<6)|(0<<4));	//Power Control 1.(0x16b0)
		Write_Cmd_Data(0x11,0x0007);								//Power Control 2.(0x0001)
		Write_Cmd_Data(0x12,(1<<8)|(1<<4)|(0<<0));				//Power Control 3.(0x0138)
		Write_Cmd_Data(0x13,0x0b00);								//Power Control 4.
		Write_Cmd_Data(0x29,0x0000);								//Power Control 7.
	
		Write_Cmd_Data(0x2b,(1<<14)|(1<<4));	    
		Write_Cmd_Data(0x50,0);	//Set X Star
		//水平GRAM终止位置Set X End.
		Write_Cmd_Data(0x51,239);	//Set Y Star
		Write_Cmd_Data(0x52,0);	//Set Y End.t.
		Write_Cmd_Data(0x53,319);	//
	
		Write_Cmd_Data(0x60,0x2700);	//Driver Output Control.
		Write_Cmd_Data(0x61,0x0001);	//Driver Output Control.
		Write_Cmd_Data(0x6a,0x0000);	//Vertical Srcoll Control.
	
		Write_Cmd_Data(0x80,0x0000);	//Display Position? Partial Display 1.
		Write_Cmd_Data(0x81,0x0000);	//RAM Address Start? Partial Display 1.
		Write_Cmd_Data(0x82,0x0000);	//RAM Address End-Partial Display 1.
		Write_Cmd_Data(0x83,0x0000);	//Displsy Position? Partial Display 2.
		Write_Cmd_Data(0x84,0x0000);	//RAM Address Start? Partial Display 2.
		Write_Cmd_Data(0x85,0x0000);	//RAM Address End? Partial Display 2.
	
		Write_Cmd_Data(0x90,(0<<7)|(16<<0));	//Frame Cycle Contral.(0x0013)
		Write_Cmd_Data(0x92,0x0000);	//Panel Interface Contral 2.(0x0000)
		Write_Cmd_Data(0x93,0x0001);	//Panel Interface Contral 3.
		Write_Cmd_Data(0x95,0x0110);	//Frame Cycle Contral.(0x0110)
		Write_Cmd_Data(0x97,(0<<8));	//
		Write_Cmd_Data(0x98,0x0000);	//Frame Cycle Contral.	   
		Write_Cmd_Data(0x07,0x0173);	//(0x0173)


 
#else

		// delayms(50); // delay 50 ms 
	//	Write_Cmd_Data(0x0000,0x0001);
	//	delayms(50); // delay 50 ms 

		/*  Write_Cmd_Data(0x0000,0x0001);//打开晶振
		  Write_Cmd_Data(0x0003,0xA8A4);//0xA8A4
		  Write_Cmd_Data(0x000C,0x0000);    
		  Write_Cmd_Data(0x000D,0x080C);   
		  Write_Cmd_Data(0x000E,0x2B00);    
		  Write_Cmd_Data(0x001E,0x00B0);    
		  Write_Cmd_Data(0x0001,0x2B3F);//驱动输出控制320*240  0x6B3F 293F 2B3F 6B3F 7A3F
		  Write_Cmd_Data(0x0002,0x0000);
		  Write_Cmd_Data(0x0010,0x0000);	 
		  Write_Cmd_Data(0x0011,0x6830);
		  Write_Cmd_Data(0x0005,0x0000);  
		  Write_Cmd_Data(0x0006,0x0000);  
		  Write_Cmd_Data(0x0016,0xEF1C);  //设置每行有效像素的数目。每行有效像素数等于到XL[7:0]+1
		  Write_Cmd_Data(0x0017,0x0003);  
		  Write_Cmd_Data(0x0007,0x0233); //0x0233       
		  Write_Cmd_Data(0x000B,0x5308); //帧周期控制 65
		  Write_Cmd_Data(0x000F,0x0000); //栅极扫描开始地址
		  Write_Cmd_Data(0x0041,0x0000); //垂直滚动控制 
		  Write_Cmd_Data(0x0042,0x0000); //垂直滚动控制  
		  Write_Cmd_Data(0x0048,0x0000);  //第一个局部显示的起始位置 SS1[8:0]
		  Write_Cmd_Data(0x0049,0x013F);  //第一个局部显示的结束位置SE1[8:0]  SS1<SE1<13EF
		  Write_Cmd_Data(0x004A,0x0000);  //第二个局部显示的起始位置
		  Write_Cmd_Data(0x004B,0x0000);  //第二个局部显示的结束位置
		  Write_Cmd_Data(0x0044,0xEF00); //水平RAM的起始-结束地址位置 (00~EF)
		  Write_Cmd_Data(0x0045,0x0000);  //垂直RAM的起始地址 00
		  Write_Cmd_Data(0x0046,0x013F); //垂直RAM的结束地址 13F
		  Write_Cmd_Data(0x0030,0x0707);  
		  Write_Cmd_Data(0x0031,0x0204);  
		  Write_Cmd_Data(0x0032,0x0204);  
		  Write_Cmd_Data(0x0033,0x0502);  
		  Write_Cmd_Data(0x0034,0x0507);  
		  Write_Cmd_Data(0x0035,0x0204);  
		  Write_Cmd_Data(0x0036,0x0204);  
		  Write_Cmd_Data(0x0037,0x0502);  
		  Write_Cmd_Data(0x003A,0x0302);  
		  Write_Cmd_Data(0x003B,0x0302);  
		  Write_Cmd_Data(0x0023,0x0000); //RAM写入数据 
		  Write_Cmd_Data(0x0024,0x0000);  //RAM写入数据
		  Write_Cmd_Data(0x0025,0x8000); //帧频率 510K
		  Write_Cmd_Data(0x004f,0);        //设置GDDRAM Y的计数地址
		  Write_Cmd_Data(0x004e,0);        //设置GDDRAM X的计数地址 	*/


		Write_Cmd_Data(0x00, 0x0001); /*Start internal OSC */
		Write_Cmd_Data(0x01, 0x3B3F); /*Driver output control */
		Write_Cmd_Data(0x02, 0x0600); /* set 1 line inversion	*/
		/*-------- Power control setup --------*/
		Write_Cmd_Data(0x0C, 0x0007); /* Adjust VCIX2 output voltage */
		Write_Cmd_Data(0x0D, 0x0006); /* Set amplitude magnification of VLCD63 */
		Write_Cmd_Data(0x0E, 0x3200); /* Set alternating amplitude of VCOM */
		Write_Cmd_Data(0x1E, 0x00BB); /* Set VcomH voltage */
		Write_Cmd_Data(0x03, 0x6A64); /* Step-up factor/cycle setting  */
		/*-------- RAM position control --------*/
		Write_Cmd_Data(0x0F, 0x0000); /* Gate scan position start at G0 */
		Write_Cmd_Data(0x44, 0xEF00); /* Horizontal RAM address position */
		Write_Cmd_Data(0x45, 0x0000); /* Vertical RAM address start position*/
		Write_Cmd_Data(0x46, 0x013F); /* Vertical RAM address end position */
		/* ------ Adjust the Gamma Curve -------*/
		Write_Cmd_Data(0x30, 0x0000);
		Write_Cmd_Data(0x31, 0x0706);
		Write_Cmd_Data(0x32, 0x0206);
		Write_Cmd_Data(0x33, 0x0300);
		Write_Cmd_Data(0x34, 0x0002);
		Write_Cmd_Data(0x35, 0x0000);
		Write_Cmd_Data(0x36, 0x0707);
		Write_Cmd_Data(0x37, 0x0200);
		Write_Cmd_Data(0x3A, 0x0908);
		Write_Cmd_Data(0x3B, 0x0F0D);
		/*--------- Special command -----------*/
		Write_Cmd_Data(0x28, 0x0006); /* Enable test command	*/
		Write_Cmd_Data(0x2F, 0x12EB); /* RAM speed tuning	 */
		Write_Cmd_Data(0x26, 0x7000); /* Internal Bandgap strength */
		Write_Cmd_Data(0x20, 0xB0E3); /* Internal Vcom strength */
		Write_Cmd_Data(0x27, 0x0044); /* Internal Vcomh/VcomL timing */
		Write_Cmd_Data(0x2E, 0x7E45); /* VCOM charge sharing time */ 
		/*--------- Turn On display ------------*/
		Write_Cmd_Data(0x10, 0x0000); /* Sleep mode off */
		delayms(30);              /* Wait 30mS  */
		Write_Cmd_Data(0x11, 0x6870); /* Entry mode setup. 262K type B, take care on the data bus with 16it only */
		Write_Cmd_Data(0x07, 0x0033); /* Display ON	*/
#endif		

	
	delayms(100);

	
	//	Write_Cmd_Data(0x0022);//		
}


void LCD_SetPos(unsigned int x0,unsigned int x1,unsigned int y0,unsigned int y1)
{
	Write_Cmd_Data(0x46, x1<<8|x0);   //一次性设定x1,x2(高)
    Write_Cmd_Data(0x47, y1); //y2
    Write_Cmd_Data(0x48, y0);  //y1
    Write_Cmd_Data(0x20, x0);  //设定RAM开始写的地址
    Write_Cmd_Data(0x21, y0);
    Write_Cmd(0x22); //设定好写寄存器,开始写
}

void  Write_Cmd_Data(uint cmd,uint dat)  
{
	Write_Cmd(cmd);
	Write_Data(dat);
}

void ClearScreen(unsigned int bColor)
{
	uint i,j;
	LCD_SetPos(0,239,0,319);
	for (i=0;i<320;i++)
	{
		for(j=0;j<240;j++ )
		{
			Write_Data(bColor);
		}
	}
} 

void Fill_Rectangle(uint x,uint y,uint x1,uint y1,uint color)
{
	uint i,j;
	LCD_SetPos(x,x1,y,y1);
	for(i=y;i<y1;i++)
	{
		for(j=x;j<x1;j++)
		{
			Write_Data(color);
		}
	}
}


void Put_pixel(unsigned int x,unsigned int y,unsigned int color)
{
	LCD_SetPos(x,x,y,y);
	Write_Data(color);
}

#include "8x16.h"

void LCD_PutChar8x16(unsigned short x, unsigned short y, char c, unsigned int fColor, unsigned int bColor)
{
	uint i,j;
	LCD_SetPos(x,x+7,y,y+15);
	for (i=0;i<16;i++)
	{
		uchar m=Font8x16[c*16+i];
		for (j=0;j<8;j++)
		{
			if((m&0x80)==0x80)
			{
				Write_Data(fColor);
			}
			else 
			{	
				Write_Data(bColor);
			}
			m<<=1;
		}			
	}
}

#include "GB1616.h"
void PutGB1616(unsigned short x, unsigned short  y, unsigned char c[2], unsigned int fColor,unsigned int bColor)
{
	uint i,j,k;
	LCD_SetPos(x,x+15,y,y+15);
	for(i=0;i<HANZIGESHU;i++)
	{
		if(codeGB_16[i].Index[0]==c[0]&&codeGB_16[i].Index[1]==c[1])
		{
			for(j=0;j<32;j++)
			{
				uchar m=codeGB_16[i].Msk[j];
				for(k=0;k<8;k++)
				{
					if((m&0x80)==0x80)
					{
						Write_Data(fColor);
				 	}
					else
					{
						Write_Data(bColor);
					}
					m<<=1;
				}
			}
		}
	}
}

void Line(unsigned int X0,unsigned int Y0,unsigned int X1,unsigned int Y1,unsigned int color)
{
	int dx = X1 - X0;
	int dy = Y1 - Y0;
	//int P  = 2 * dy - dx;
	//int dobDy = 2 * dy;
	//int dobD = 2 * (dy - dx);
	int PointX = 0,PointY = 0;
	int incx = 0,incy = 0;
	int distance = 0,xerr = 0,yerr = 0;
	unsigned int i = 0;
	if(dx == 0)
	{
		PointX = X0;
		if(Y0 < Y1)
		{
			PointY = Y0;
		}
		else{
			PointY = Y1;
		}
		for(i = 0;i <= ((Y0<Y1) ? (Y1-Y0) : (Y0-Y1));i++)
		{
			Put_pixel(PointX,PointY,color);
			PointY++;
		}
		return;
	}
	if(dy == 0)	
	{
		PointY = Y0;
		if(X0 < X1)
		{
			PointX = X0;
		}
		else{
			PointX = X1;
		}
		for(i = 0;i <= ((X0<X1) ? (X1-X0) : (X0-X1));i++)
		{
			Put_pixel(PointX,PointY,color);
			PointX++;
		}
		return;
	}

	if(dx > 0)
		incx = 1;
	else if(dx == 0)
		incx = 0;
	else
		incx = -1;

	if(dy > 0)
		incy = 1;
	else if(dy == 0)
		incy = 0;
	else
		incy = -1;

    dx = ((X0>X1) ? (X0-X1) : (X1-X0));
    dy = ((Y0>Y1) ? (Y0-Y1) : (Y1-Y0));

    if(dx>dy) distance=dx;
    else distance=dy;

    PointX = X0;
    PointY = Y0;
    for(i=0;i<=distance+1;i++){
    	Put_pixel(PointX,PointY,color);
        xerr+=dx;
        yerr+=dy;
        if(xerr>distance){
            xerr-=distance;
            PointX+=incx;
        }
        if(yerr>distance){
            yerr-=distance;
            PointY+=incy;
        }
    }
}


void Rectangle(unsigned int left,unsigned int top,unsigned int right,unsigned int bottom,unsigned int color){
	Line(left,top,right,top,color);
	Line(left,top,left,bottom,color);
	Line(right,top,right,bottom,color);
	Line(left,bottom,right,bottom,color);
}

void Show_Touch(unsigned int x,unsigned int y,unsigned int Color){
	Put_pixel(x-1,y,Color);  	
	Put_pixel(x,y-1,Color); 
	Put_pixel(x-1,y-1,Color); 
	Put_pixel(x,y,Color);
	Put_pixel(x+1,y,Color);
	Put_pixel(x,y+1,Color);
	Put_pixel(x+1,y+1,Color);
	Put_pixel(x-1,y+1,Color);
	Put_pixel(x+1,y-1,Color);
}

//*************************新添加的************************************//

void LCD_PutChar(unsigned short x, unsigned short y, char c, unsigned int fColor, unsigned int bColor) {
	LCD_PutChar8x16( x, y, c, fColor, bColor );
}



void LCD_PutString(unsigned short x, unsigned short y, unsigned char *s, unsigned int fColor, unsigned int bColor) {
	unsigned char l=0;
	while(*s) {
		if( *s < 0x80) {
			LCD_PutChar(x+l*8,y,*s,fColor,bColor);
			s++;l++;
		}
		else{
			PutGB1616(x+l*8,y,(unsigned char*)s,fColor,bColor);
			s+=2;l+=2;
		}
	}
}


void print_num(uint x,uint y,uint num){
	LCD_PutChar(x,y,num/1000+48,Black,White);
	LCD_PutChar(x+8,y,num%1000/100+48,Black,White);
	LCD_PutChar(x+16,y,num%100/10+48,Black,White);
	LCD_PutChar(x+24,y,num%10+48,Black,White);
}

unsigned char  image[]={ 
0XFF,0XFF,0XFF,0XFF,0XFF,0XFF,0XFF,0XFF,0XFF,0XFF,0XFF,0XFF,0XFF,0XFF,0XFF,0XFF,
0XFF,0XFF,0XFF,0XFF,0XFF,0XFF,0XFF,0XFF,0XFF,0XFF,0XFF,0XFF,0XBE,0XF7,0X7D,0XEF,
0XBA,0XD6,0XB6,0XB5,0XF3,0X9C,0XB2,0X94,0XB3,0X9C,0XB2,0X94,0X34,0XA5,0XF7,0XBD,
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0XB7,0XAD,0X79,0XC6,0X3C,0XE7,0XBE,0XF7,0XFF,0XFF,0XFF,0XFF,0XFF,0XFF,0XFF,0XFF,
};


 
void showimage() //显示40*40图片
{
  	int i; 
  
//	for(k=3;k<8;k++)
//	{
//	   	for(j=0;j<6;j++)
//		{	
//			LCD_SetPos(40*j,40*k,40*j+39,40*k+39);		//坐标设置
//		    for(i=0;i<1600;i++)
//			 { 		
//			  	 Write_Data(image[i]);	 //发送颜色数据为提高速度高8位低8位分别传递	   						
//			 }	
//		 }
//	}

	
			LCD_SetPos(0,40,0,40);		//坐标设置
		    for(i=0;i<1600;i++)
			 { 		
			  	 Write_Data(image[i]);	 //发送颜色数据为提高速度高8位低8位分别传递	   						
			 }	

//	ref=0;				
}		











